## arch/arm/mach-msm/lge/fx3/Kconfig
```kconfig
config BOARD_HEADER_FILE
	string "LGE board specific header file name"
	default ""

config MACH_MSM8930_FX3
	depends on ARCH_MSM8930
	select MACH_LGE
	bool "MSM8930 FX3"
	help
	  Support for the LGE MSM8930 FX3 device.

config MACH_LGE_FX3_SPCS
	bool "LGE FX3 SPCS board"
	depends on MACH_MSM8930_FX3

config MACH_LGE_FX3_MPCS
	bool "LGE FX3 MPCS board"
	depends on MACH_MSM8930_FX3

config MACH_LGE_FX3_VZW
	bool "LGE FX3 VZW board"
	depends on MACH_MSM8930_FX3

config MACH_LGE_FX3_TMUS
	bool "LGE FX3 TMUS board"
	depends on MACH_MSM8930_FX3

config MACH_LGE_FX3_ATT
	bool "LGE FX3 AT&T board"
	depends on MACH_MSM8930_FX3

config MACH_LGE_FX3_EUR
	bool "LGE FX3 EUR board"
	depends on MACH_MSM8930_FX3
	
config MACH_LGE_F6_TMUS
	bool "LGE F6 TMUS board"
	depends on MACH_MSM8930_FX3	

config MACH_LGE_FX3_SPCSTRF
    bool "LGE FX3 TRF board"
    depends on MACH_MSM8930_FX3


config MACH_LGE_FX3_WCDMA_TRF_US
	bool "LGE FX3 WCDMA TRF US board"
	depends on MACH_MSM8930_FX3

config LGE_PM8038_KPJT
	bool "LGE FX3 SPCS board"
	depends on MACH_MSM8930_FX3

config MACH_LGE_FX3_CRK
	bool "LGE FX3 CRK board"
	depends on MACH_MSM8930_FX3
```
